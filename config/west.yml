## config/west.yml
```yaml
manifest:
  remotes:
    - name: zmkfirmware
      url-base: https://github.com/zmkfirmware
  projects:
    - name: alu40-module
      url: https://github.com/polarityworks/zmk-config-alu40
      revision: main
      clone-depth: 1
    - name: zmk
      remote: zmkfirmware
      revision: abb64ba316c29caddc49727ca2cac2f0ed5970c7
      import: app/west.yml
  self:
    path: config
```
